module alu_card(
	input wire VCC,
	input wire GND,
	input wire clk,				// generated by motherboard clock generator
	input wire rst_n,			// probably a button on the motherboard
	input reg we_n,			// active low
	input reg oe_n,			// active low
	inout wire [7:0] data,
	input wire [15:0] addr,	    // 64k address space is suppored by default. More address bits may be added later
	output wire int_n			// pulled up by motherboard; driven down by any peripheral (could be used for interrupts)
);

wire ce;		// chip enable signal
wire we1_n;	    // true write enable signal
wire oe1_n; 	    // true output enable signal

// this circuit should use 2 8-input NANDs, 1 hex inverter, and 1 4x 2-input NAND
assign ce = addr[15:3] == 16'b0101_0000_0000_0; // start 20k, 8 bytes wide
assign we1_n = ~(ce & ~we_n);
assign oe1_n = ~(ce & ~oe_n);

// get FS signal
wire [2:0] fs;
assign fs = addr[2:0];

reg [7:0] q;
assign data = oe1_n == 1'b0 ? q : 8'bz;

reg [7:0] alu_res;

always @(*) begin
	case (fs)
		3'b000: alu_res = data + 1;
		3'b001: alu_res = data - 1;
		default: alu_res = 8'bx;
	endcase
end


always @(posedge clk) begin
	if (rst_n == 1'b0) begin
		q <= 8'd0;
	end else if (we1_n == 1'b0) begin
		q <= alu_res;
	end
end

endmodule